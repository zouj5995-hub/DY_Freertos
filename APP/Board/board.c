#include "board.h"



/*******************************************************************************
 * 名称  ：board_out_t
 * 功能  ：一路输出的硬件描述
 ******************************************************************************/
typedef struct
{
    GPIO_TypeDef *port;          // 端口，如 GPIOE
    uint16_t      pin;           // 引脚，如 GPIO_PIN_9
    uint8_t       active_level;  // 有效电平：1=高电平为“开”，0=低电平为“开”
    const char   *name;          // 设备名（打印/日志用）
} board_out_t;

/* Private variables ---------------------------------------------------------*/

/*******************************************************************************
 * 名称  ：out_table
 * 功能  ：8 台设备的引脚表
 * 说明  ：换板子、改引脚、改极性，只改这张表，别处一行不用动
 ******************************************************************************/
static const board_out_t out_table[DEV_CNT] =
{
    [DEV_IPC]    = { GPIOE, GPIO_PIN_9,  1, "IPC   " },   // 工控机  PE9
    [DEV_SONAR]  = { GPIOA, GPIO_PIN_0,  1, "SONAR " },   // 声纳    PA0
    [DEV_BD]     = { GPIOA, GPIO_PIN_4,  1, "BD    " },   // 北斗    PA4
    [DEV_BK1]    = { GPIOC, GPIO_PIN_3,  1, "BK1   " },   // 备用一  PC3
    [DEV_RADAR]  = { GPIOB, GPIO_PIN_3,  1, "RADAR " },   // 雷达    PB3
    [DEV_CAMERA] = { GPIOD, GPIO_PIN_7,  1, "CAMERA" },   // 摄像头  PD7
    [DEV_BK2]    = { GPIOD, GPIO_PIN_3,  1, "BK2   " },   // 备用二  PD3
    [DEV_BK3]    = { GPIOA, GPIO_PIN_11, 1, "BK3   " },   // 备用三  PA11
};

/* Private functions prototypes ----------------------------------------------*/
static GPIO_PinState board_to_level(const board_out_t *o, bool on);
static void board_main12v_init(void);                              // 12V 总控引脚初始化并保持接通

/* Private functions ---------------------------------------------------------*/

/*******************************************************************************
 * 函数名：board_to_level
 * 功  能：把“想要的状态”按有效电平翻译成实际要写的电平
 * 参  数：o  —— 某一路输出的硬件描述
 *         on —— true 想开，false 想关
 * 返回值：GPIO_PIN_SET（高）或 GPIO_PIN_RESET（低）
 * 说  明：静态函数，仅本文件使用
 ******************************************************************************/
static GPIO_PinState board_to_level(const board_out_t *o, bool on)
{
    return on ? (GPIO_PinState)o->active_level : (GPIO_PinState)!o->active_level;
}

/*******************************************************************************
 * 函数名：board_main12v_init
 * 功  能：初始化 12V 总控引脚并把它置于接通状态
 * 参  数：无
 * 返回值：无
 * 说  明：总控不参与供电决策，但若硬件仍串在 12V 回路中必须保持接通，
 *         否则雷达/摄像头/备用二/备用三永远无法上电；
 *         板上已取消总控时把 BOARD_MAIN12V_ENABLE 置 0 即可跳过
 ******************************************************************************/
static void board_main12v_init(void)
{
    GPIO_InitTypeDef init = {0};

    /*==============================
     *  #1. 配置总控引脚为推挽输出
     *==============================*/
    __HAL_RCC_GPIOE_CLK_ENABLE();                       // 使能 GPIOE 时钟
    init.Pin   = BOARD_MAIN12V_PIN;                     // 总控引脚
    init.Mode  = GPIO_MODE_OUTPUT_PP;                   // 推挽输出
    init.Pull  = GPIO_NOPULL;                           // 不需要上下拉
    init.Speed = GPIO_SPEED_FREQ_LOW;                   // 低速即可
    HAL_GPIO_Init(BOARD_MAIN12V_PORT, &init);           // 应用配置

    /*==============================
     *  #2. 置于接通状态
     *==============================*/
    HAL_GPIO_WritePin(BOARD_MAIN12V_PORT, BOARD_MAIN12V_PIN, BOARD_MAIN12V_ON_LEVEL);
}

/* Exported functions --------------------------------------------------------*/

/*******************************************************************************
 * 函数名：board_init
 * 功  能：把所有设备置于“断电”状态
 * 参  数：无
 * 返回值：无
 * 说  明：上电安全默认，必须在任何控制动作之前调用
 ******************************************************************************/
void board_init(void)
{
    /*============================
     *   #1. 逐台设备写入“关”
     ============================*/
    for (int i = 0; i < DEV_CNT; i++)                   // 遍历全部逻辑设备
    {
        board_power_set((dev_id_t)i, false);            // false = 断电
    }

#if (BOARD_MAIN12V_ENABLE == 1)
    board_main12v_init();                               // 12V 总控保持接通
#endif
}

/*******************************************************************************
 * 函数名：board_power_set
 * 功  能：给指定设备供电或断电
 * 参  数：dev —— 设备逻辑编号；on —— true 供电，false 断电
 * 返回值：无
 ******************************************************************************/
void board_power_set(dev_id_t dev, bool on)
{
    /*============================
     *   #1. 参数检查，防止越界
     ============================*/
    if (dev >= DEV_CNT)  return;                             // 编号非法直接返回

    /*/========================================================
     *   #2. 查表取出这一路的硬件描述，翻译成电平后写到引脚
     ========================================================*/
    const board_out_t *o = &out_table[dev];             // 取出对应的一行
    HAL_GPIO_WritePin(o->port, o->pin, board_to_level(o, on));  // 真正写引脚
}

/*******************************************************************************
 * 函数名：board_power_get
 * 功  能：读回指定设备当前的输出状态
 * 参  数：dev —— 设备逻辑编号
 * 返回值：true 当前为“供电”，false 为“断电”
 ******************************************************************************/
bool board_power_get(dev_id_t dev)
{
    /*=================
        #1. 参数检查
     =================*/
    if (dev >= DEV_CNT)                                 // 编号非法
    {
        return false;
    }

    /*===================================================
     *   #2. 读引脚电平，再按“有效电平”还原成“开/关”
     ===================================================*/
    const board_out_t *o = &out_table[dev];             // 取出对应的一行
    return (HAL_GPIO_ReadPin(o->port, o->pin) == board_to_level(o, true));  // 与“开”的电平比较
}

/*******************************************************************************
 * 函数名：board_dev_name
 * 功  能：取设备名
 * 参  数：dev —— 设备逻辑编号
 * 返回值：设备名字符串；编号非法时返回 "???"
 ******************************************************************************/
const char *board_dev_name(dev_id_t dev)
{
    /*************
     *   #1. 参数检查后返回名字
     *************/
    if (dev >= DEV_CNT)                                 // 编号非法
    {
        return "???";
    }
    return out_table[dev].name;                         // 返回表里的名字
}
