/*******************************************************************************
 * 文件   ：uart485.c
 * 功能   ：RS485 半双工串口收发实现
 * 说明   ：发送前把方向脚置为发送、发完等 TC 标志再切回接收；
 *          接收用"每字节中断 + 总线空闲(IDLE)判帧"，收到完整帧后置标志
 ******************************************************************************/

/* Includes ------------------------------------------------------------------*/
#include "uart485.h"
#include "board.h"
#include "delay_us.h"
#include "log.h"
#include "usart.h"
#include "FreeRTOS.h"
#include "task.h"
#include "semphr.h"
#include <stddef.h>
#include <string.h>

/* Private define ------------------------------------------------------------*/
#define UART485_DIR_DELAY_US    10U     // 方向切换后的稳定延时（微秒）
#define UART485_TX_TIMEOUT_MS   1000U   // 单次发送超时（毫秒）

/* Private variables ---------------------------------------------------------*/
static uint8_t           s_rx_buf[UART485_RX_BUF_SIZE];      // 接收缓冲区
static volatile uint16_t s_rx_len     = 0U;                 // 已接收字节数
static volatile bool     s_frame_ready = false;             // 是否收到完整帧
static SemaphoreHandle_t s_tx_mutex   = NULL;               // 发送互斥量（多任务排队）
static volatile uint32_t s_stat_rx_bytes = 0U;           // 【诊断】收到字节数
static volatile uint32_t s_stat_idle_cnt = 0U;           // 【诊断】总线空闲次数
static volatile uint32_t s_stat_tx_cnt   = 0U;           // 【诊断】发送帧数

/* Private functions prototypes ----------------------------------------------*/
static void uart485_set_dir(UART_HandleTypeDef *huart, bool tx);    // 设置 485 方向脚

/* Private functions ---------------------------------------------------------*/

/*******************************************************************************
 * 函数名：uart485_set_dir
 * 功  能：设置指定串口对应的 485 方向脚
 * 参  数：huart —— 串口句柄；tx —— true 为发送方向，false 为接收方向
 * 返回值：无
 * 说  明：方向脚的电平定义在 board.h 中（BOARD_485_DIR_TX_LEVEL）
 ******************************************************************************/
static void uart485_set_dir(UART_HandleTypeDef *huart, bool tx)
{
    GPIO_PinState level;

    /*==============================
     *  #1. 按方向换算目标电平
     *==============================*/
    if (tx)
    {
        level = BOARD_485_DIR_TX_LEVEL;                     // 发送电平
    }
    else
    {
        level = (BOARD_485_DIR_TX_LEVEL == GPIO_PIN_SET) ?
                GPIO_PIN_RESET : GPIO_PIN_SET;              // 接收电平与发送相反
    }

    /*==============================
     *  #2. 按串口实例写对应方向脚
     *==============================*/
    if (huart->Instance == USART2)                          // 服务器/北斗链路
    {
        HAL_GPIO_WritePin(BOARD_U2_DIR_PORT, BOARD_U2_DIR_PIN, level);
    }
    else if (huart->Instance == USART3)                     // 工控机链路
    {
        HAL_GPIO_WritePin(BOARD_U3_DIR_PORT, BOARD_U3_DIR_PIN, level);
    }
    else
    {
        /* 其它串口无需方向控制 */
    }
}

/* Exported functions --------------------------------------------------------*/

/*******************************************************************************
 * 函数名：uart485_init
 * 功  能：初始化 485 方向脚与发送互斥量
 * 参  数：无
 * 返回值：无
 * 说  明：必须在启动调度器之前调用；引脚配置由 CubeMX 生成的 gpio.c 完成
 ******************************************************************************/
void uart485_init(void)
{
    /*==============================
     *  #1. 创建发送互斥量
     *==============================*/
    s_tx_mutex = xSemaphoreCreateMutex();                   // 保证同一时刻只有一路在发

    /*==============================
     *  #2. 复位接收状态并默认置为接收方向
     *==============================*/
    s_rx_len      = 0U;                                     // 清空接收长度
    s_frame_ready = false;                                  // 清空完成标志

    uart485_set_dir(&huart2, false);                        // USART2 默认接收
    uart485_set_dir(&huart3, false);                        // USART3 默认接收
}

/*******************************************************************************
 * 函数名：uart485_send
 * 功  能：通过 485 发送一帧数据
 * 参  数：huart —— 串口句柄
 *         data  —— 待发送数据
 *         len   —— 数据长度
 * 返回值：true 表示发送成功，false 表示失败
 * 说  明：发送期间持锁，且发完必须等发送完成标志再切回接收，
 *         否则会把自己的尾巴吃掉（485 半双工典型问题）
 ******************************************************************************/
bool uart485_send(UART_HandleTypeDef *huart, const uint8_t *data, uint16_t len)
{
    bool ok = false;

    /*==============================
     *  #1. 参数检查
     *==============================*/
    if ((huart == NULL) || (data == NULL) || (len == 0U))
    {
        return false;                                       // 参数无效
    }

    /*==============================
     *  #2. 取发送锁（同一时刻只允许一路发送）
     *==============================*/
    if ((s_tx_mutex != NULL) &&
        (xSemaphoreTake(s_tx_mutex, pdMS_TO_TICKS(500)) != pdTRUE))
    {
        LOG_WARNING("485 发送取锁超时");
        return false;                                       // 取锁失败
    }

    /*==============================
     *  #3. 切到发送方向并留出稳定时间
     *==============================*/
    uart485_set_dir(huart, true);                           // 方向脚切发送
    delay_us(UART485_DIR_DELAY_US);                         // 等待收发器稳定

    /*==============================
     *  #4. 阻塞发送整帧
     *==============================*/
    if (HAL_UART_Transmit(huart, (uint8_t *)data, len, UART485_TX_TIMEOUT_MS) == HAL_OK)
    {
        /*==============================
         *  #5. 等发送完成标志，确保最后一个字节已出总线
         *==============================*/
        uint32_t tick_start = HAL_GetTick();

        while (__HAL_UART_GET_FLAG(huart, UART_FLAG_TC) == RESET)
        {
            if ((HAL_GetTick() - tick_start) > UART485_TX_TIMEOUT_MS)
            {
                break;                                      // 超时保护
            }
        }

        s_stat_tx_cnt++;                                    // 发送计数
        ok = true;                                          // 发送成功
    }
    else
    {
        LOG_ERROR("485 发送失败");                          // 发送失败
    }

    /*==============================
     *  #6. 切回接收方向并释放锁
     *==============================*/
    delay_us(UART485_DIR_DELAY_US);                         // 等总线稳定
    uart485_set_dir(huart, false);                          // 方向脚切接收

    if (s_tx_mutex != NULL)
    {
        xSemaphoreGive(s_tx_mutex);                         // 释放发送锁
    }

    return ok;
}

/*******************************************************************************
 * 函数名：uart485_start_rx
 * 功  能：启动 USART2 的单字节接收中断
 * 参  数：无
 * 返回值：无
 * 说  明：须在 uart485_init 之后、调度器启动前调用
 ******************************************************************************/
void uart485_start_rx(void)
{
    /*==============================
     *  #1. 复位接收计数并开启首字节中断
     *==============================*/
    s_rx_len      = 0U;                                     // 从 0 开始
    s_frame_ready = false;                                  // 清空完成标志

    (void)HAL_UART_Receive_IT(&huart2, &s_rx_buf[s_rx_len], 1U);   // 每收 1 字节进一次中断
    __HAL_UART_ENABLE_IT(&huart2, UART_IT_IDLE);           // 【关键】打开总线空闲中断，否则永远判不出帧结束
}

/*******************************************************************************
 * 函数名：uart485_rx_byte_isr
 * 功  能：USART2 单字节接收完成处理（中断上下文）
 * 参  数：huart —— 串口句柄
 * 返回值：无
 * 说  明：只做搬运与计数，不做解析、不打印、不调阻塞接口
 ******************************************************************************/
void uart485_rx_byte_isr(UART_HandleTypeDef *huart)
{
    /*==============================
     *  #1. 接收长度自增并防溢出
     *==============================*/
    if (huart->Instance != USART2)                          // 只处理 USART2
    {
        return;
    }

    s_stat_rx_bytes++;                                      // 收到一个字节
    if (s_rx_len < (UART485_RX_BUF_SIZE - 1U))              // 留一个字节给结束符
    {
        s_rx_len++;                                         // 指向下一个位置
    }
    else
    {
        s_rx_len = 0U;                                      // 溢出则整帧丢弃
    }

    /*==============================
     *  #2. 继续接收下一个字节
     *==============================*/
    (void)HAL_UART_Receive_IT(&huart2, &s_rx_buf[s_rx_len], 1U);
}

/*******************************************************************************
 * 函数名：uart485_idle_isr
 * 功  能：USART2 总线空闲处理（中断上下文），标志一帧接收结束
 * 参  数：huart —— 串口句柄
 * 返回值：无
 * 说  明：IDLE 表示总线上超过一个字节时间没有新数据，可视为帧结束
 ******************************************************************************/
void uart485_idle_isr(UART_HandleTypeDef *huart)
{
    /*==============================
     *  #1. 清空闲标志并停止当前接收
     *==============================*/
    if (huart->Instance != USART2)                          // 只处理 USART2
    {
        return;
    }

    __HAL_UART_CLEAR_IDLEFLAG(&huart2);                     // 清 IDLE 标志
    (void)HAL_UART_AbortReceive_IT(&huart2);                // 中止逐字节接收

    /*==============================
     *  #2. 标记收到完整帧（由通信任务取走）
     *==============================*/
    s_stat_idle_cnt++;                                      // 空闲中断触发
    if (s_rx_len > 0U)                                      // 有数据才算一帧
    {
        s_frame_ready = true;                               // 置完成标志
    }
    else
    {
        uart485_start_rx();                                 // 空帧则重启接收
    }
}

/*******************************************************************************
 * 函数名：uart485_rx_ready
 * 功  能：查询是否已收到完整帧
 * 参  数：无
 * 返回值：true 表示有一帧待处理
 ******************************************************************************/
bool uart485_rx_ready(void)
{
    /*==============================
     *  #1. 直接返回标志
     *==============================*/
    return s_frame_ready;                                   // 由中断置位、任务清除
}

/*******************************************************************************
 * 函数名：uart485_rx_take
 * 功  能：取走收到的完整帧，并重新启动接收
 * 参  数：dst     —— 目标缓冲区
 *         max_len —— 目标缓冲区容量
 * 返回值：取到的字节数（0 表示无数据）
 * 说  明：只有通信任务调用本函数，保证"取帧"是单线程的
 ******************************************************************************/
uint16_t uart485_rx_take(uint8_t *dst, uint16_t max_len)
{
    uint16_t len;

    /*==============================
     *  #1. 参数检查
     *==============================*/
    if ((dst == NULL) || (max_len == 0U))
    {
        return 0U;                                          // 参数无效
    }

    /*==============================
     *  #2. 复制并截断到目标缓冲区
     *==============================*/
    len = s_rx_len;                                         // 当前帧长度

    if (len > max_len)
    {
        len = max_len;                                      // 超长则截断
    }

    memcpy(dst, s_rx_buf, len);                             // 复制整帧
    dst[len < max_len ? len : (max_len - 1U)] = '\0';       // 便于日志打印

    /*==============================
     *  #3. 清状态并重启接收
     *==============================*/
    s_frame_ready = false;                                  // 清除完成标志
    uart485_start_rx();                                     // 重新开始收下一帧

    return len;                                             // 返回帧长
}

/*******************************************************************************
 * 函数名：uart485_get_rx_bytes
 * 功  能：读取累计收到的字节数（诊断用）
 * 参  数：无
 * 返回值：累计字节数
 ******************************************************************************/
uint32_t uart485_get_rx_bytes(void)
{
    return s_stat_rx_bytes;                                 // 收到字节总数
}

/*******************************************************************************
 * 函数名：uart485_get_idle_count
 * 功  能：读取总线空闲中断触发次数（诊断用）
 * 参  数：无
 * 返回值：触发次数
 ******************************************************************************/
uint32_t uart485_get_idle_count(void)
{
    return s_stat_idle_cnt;                                 // 空闲中断次数
}

/*******************************************************************************
 * 函数名：uart485_get_tx_count
 * 功  能：读取发送帧数（诊断用）
 * 参  数：无
 * 返回值：发送帧数
 ******************************************************************************/
uint32_t uart485_get_tx_count(void)
{
    return s_stat_tx_cnt;                                   // 发送帧总数
}
