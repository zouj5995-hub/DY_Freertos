/*******************************************************************************
 * 文件   ：delay_us.c
 * 功能   ：微秒级延时实现（基于 Cortex-M3 的 DWT 周期计数器）
 * 说明   ：软件 I2C 需要微秒级时序，而 SysTick 已被 FreeRTOS 占用，
 *          因此改用 DWT 的 CYCCNT：不占外设，也不需要 RTOS 接口
 ******************************************************************************/

/* Includes ------------------------------------------------------------------*/
#include "delay_us.h"
#include "main.h"

/* Private define ------------------------------------------------------------*/
#define DELAY_US_FALLBACK_LOOPS   8U        // DWT 不可用时的空循环系数（仅为兜底）

/* Private variables ---------------------------------------------------------*/
static bool s_dwt_ready = false;            // DWT 周期计数器是否可用

/* Exported functions --------------------------------------------------------*/

/*******************************************************************************
 * 函数名：delay_us_init
 * 功  能：初始化微秒延时功能
 * 参  数：无
 * 返回值：无
 * 说  明：必须在首次使用 delay_us 之前调用一次，通常在启动调度器前完成
 ******************************************************************************/
void delay_us_init(void)
{
    /*==============================
     *  #1. 使能跟踪单元与周期计数器
     *==============================*/
    CoreDebug->DEMCR |= CoreDebug_DEMCR_TRCENA_Msk;             // 使能跟踪单元
    DWT->CYCCNT = 0U;                                           // 周期计数清零
    DWT->CTRL |= DWT_CTRL_CYCCNTENA_Msk;                        // 使能周期计数

    /*==============================
     *  #2. 记录是否启用成功
     *==============================*/
    s_dwt_ready = ((DWT->CTRL & DWT_CTRL_CYCCNTENA_Msk) != 0U); // 读取使能位结果
}

/*******************************************************************************
 * 函数名：delay_us
 * 功  能：忙等指定微秒数
 * 参  数：us —— 需要延时的微秒数
 * 返回值：无
 * 说  明：延时期间不释放 CPU（微秒级延时本来就很短，无需让出）；
 *         DWT 不可用时退化为粗略空循环
 ******************************************************************************/
void delay_us(uint32_t us)
{
    uint32_t start;
    uint32_t ticks;

    /*==============================
     *  #1. DWT 不可用时退化处理
     *==============================*/
    if (s_dwt_ready == false)
    {
        volatile uint32_t loops = us * DELAY_US_FALLBACK_LOOPS; // 粗略空循环兜底

        while (loops-- > 0U)                                    // 防止被优化掉
        {
        }
        return;                                                 // 结束退化延时
    }

    /*==============================
     *  #2. 用周期计数器精确忙等
     *==============================*/
    ticks = us * (SystemCoreClock / 1000000U);                  // 微秒换算为周期数
    start = DWT->CYCCNT;                                        // 记录起始计数

    while ((DWT->CYCCNT - start) < ticks)                       // 差值到位即结束
    {
    }
}
