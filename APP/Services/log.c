/*******************************************************************************
 * 文件   ：log.c
 * 功能   ：日志服务实现（队列 + 串口互斥）
 * 说明   ：本文件同时包含"生产者"log_printf 与"消费者"TaskLog，
 *          因为二者必须共用同一个队列与互斥量，放一起最清晰
 ******************************************************************************/

/* Includes ------------------------------------------------------------------*/
#include "log.h"
#include "FreeRTOS.h"
#include "task.h"
#include "queue.h"
#include "semphr.h"
#include "usart.h"
#include <stdarg.h>

/* Private types -------------------------------------------------------------*/

/*******************************************************************************
 * 名称  ：log_msg_t
 * 功能  ：一条日志消息（放进队列的“信封”）
 ******************************************************************************/
typedef struct
{
    uint16_t len;                   // 文本实际长度
    char     text[LOG_TEXT_MAX];    // 文本内容（含前缀与换行）
} log_msg_t;

/* Private variables ---------------------------------------------------------*/
static QueueHandle_t     s_log_queue  = NULL;               // 日志队列
static SemaphoreHandle_t s_uart_mutex = NULL;               // 串口互斥量（保护直接输出）
static uint8_t           s_log_level  = LOG_DEFAULT_LEVEL;  // 运行期等级
static volatile uint32_t s_drop_cnt   = 0;                  // 队列满导致的丢弃计数

/* Private functions prototypes ----------------------------------------------*/
static const char *log_level_tag(uint8_t level);            // 等级转显示标签

/* Private functions ---------------------------------------------------------*/

/*******************************************************************************
 * 函数名：log_level_tag
 * 功  能：把日志等级转换成显示用的短标签
 * 参  数：level —— 日志等级
 * 返回值：标签字符串
 * 说  明：未知等级按 DEBUG 处理
 ******************************************************************************/
static const char *log_level_tag(uint8_t level)
{
    /*==============================
     *  #1. 按等级取标签
     *==============================*/
    switch (level)
    {
        case LOG_LEVEL_ERROR:   return "ERROR";
        case LOG_LEVEL_WARNING: return "WARN ";
        case LOG_LEVEL_INFO:    return "INFO ";
        default:                return "DEBUG";             // 未知等级按 DEBUG
    }
}

/* Exported functions --------------------------------------------------------*/

/*******************************************************************************
 * 函数名：log_init
 * 功  能：创建日志队列与串口互斥量
 * 参  数：无
 * 返回值：无
 * 说  明：必须在启动调度器之前调用
 ******************************************************************************/
void log_init(void)
{
    /*==============================
     *  #1. 创建队列与互斥量
     *==============================*/
    s_log_queue  = xQueueCreate(LOG_QUEUE_LEN, sizeof(log_msg_t));   // 队列：从堆分配
    s_uart_mutex = xSemaphoreCreateMutex();                          // 互斥量：保护串口

    /*=====================================
     *  #2. 任一创建失败则退化为同步输出模式
     *=====================================*/
    if ((s_log_queue == NULL) || (s_uart_mutex == NULL))
    {
        s_log_queue  = NULL;
        s_uart_mutex = NULL;
    }
}

/*******************************************************************************
 * 函数名：log_set_level
 * 功  能：设置运行期日志等级
 * 参  数：level —— 日志等级（LOG_LEVEL_xxx）
 * 返回值：无
 * 说  明：现场可用调试通道动态调整
 ******************************************************************************/
void log_set_level(uint8_t level)
{
    s_log_level = level;                                    // 单字节赋值，天然原子
}

/*******************************************************************************
 * 函数名：log_get_level
 * 功  能：读取当前运行期日志等级
 * 参  数：无
 * 返回值：当前等级
 ******************************************************************************/
uint8_t log_get_level(void)
{
    return s_log_level;                                     // 返回当前等级
}

/*******************************************************************************
 * 函数名：log_get_drop_count
 * 功  能：读取因队列满而被丢弃的日志条数
 * 参  数：无
 * 返回值：丢弃条数
 * 说  明：该值持续增长说明日志打得太频繁，应降等级
 ******************************************************************************/
uint32_t log_get_drop_count(void)
{
    return s_drop_cnt;                                      // 返回丢弃计数
}

/*******************************************************************************
 * 函数名：log_write_sync
 * 功  能：直接同步输出一段文本（用互斥量保护串口，避免与日志任务交错）
 * 参  数：text —— 文本指针；len —— 文本长度
 * 返回值：无
 * 说  明：用于调度器启动前的打印，以及任务列表这类超长文本
 ******************************************************************************/
void log_write_sync(const char *text, uint16_t len)
{
    /*================================================
     *  #1. 获取串口使用权（互斥量为空说明调度器未启动）
     *================================================*/
    if (s_uart_mutex != NULL)
    {
        xSemaphoreTake(s_uart_mutex, portMAX_DELAY);        // 取钥匙
    }

    /*========================
     *  #2. 一次性发出整段文本
     *========================*/
    HAL_UART_Transmit(&huart1, (uint8_t *)text, len, 100);  // 阻塞发送，超时 100ms

    /*====================
     *  #3. 归还串口使用权
     *====================*/
    if (s_uart_mutex != NULL)
    {
        xSemaphoreGive(s_uart_mutex);                       // 还钥匙
    }
}

/*******************************************************************************
 * 函数名：log_printf
 * 功  能：生产一条日志：格式化后投递到队列，瞬间返回
 * 参  数：level —— 日志等级
 *         file  —— 文件名（由宏填入 __FILENAME__）
 *         fmt   —— 格式化字符串
 * 返回值：无
 * 说  明：队列满时丢弃并计数，绝不阻塞调用任务
 ******************************************************************************/
void log_printf(uint8_t level, const char *file, const char *fmt, ...)
{
    log_msg_t m;                                            // 待发送信封
    va_list   ap;                                           // 可变参数
    int       n;                                            // 已写入长度

    /*====================
     *  #1. 运行期等级过滤
     *====================*/
    if (level > s_log_level)
    {
        return;                                             // 比当前等级更啰嗦，丢弃
    }

    /*==========================
     *  #2. 先写等级前缀与文件名
     *==========================*/
    n = snprintf(m.text, sizeof(m.text), "[%s] %s: ", log_level_tag(level), file);
    if ((n < 0) || (n >= (int)sizeof(m.text)))              // 前缀超长，放弃
    {
        return;
    }

    /*=====================
     *  #3. 再追加用户正文
     *=====================*/
    va_start(ap, fmt);
    int n2 = vsnprintf(m.text + n, sizeof(m.text) - (size_t)n, fmt, ap);   // 追加正文
    va_end(ap);
    if (n2 < 0)
    {
        return;                                             // 格式化失败
    }
    n += n2;

    /*========================================
     *  #4. 补齐回车换行（预留 3 字节：\r\n\0）
     *========================================*/
    if (n > ((int)sizeof(m.text) - 3))
    {
        n = (int)sizeof(m.text) - 3;                        // 超长则截断
    }
    m.text[n++] = '\r';
    m.text[n++] = '\n';
    m.len = (uint16_t)n;

    /*=================================================
     *  #5. 投递：队列未创建则同步输出，队列满则丢弃计数
     *=================================================*/
    if (s_log_queue == NULL)
    {
        log_write_sync(m.text, m.len);                      // 退化为同步输出
        return;
    }

    if (xQueueSend(s_log_queue, &m, 0) != pdTRUE)           // 超时 0：绝不等待
    {
        s_drop_cnt++;                                       // 记录一次丢弃
    }
}

/*******************************************************************************
 * 函数名：TaskLog
 * 功  能：日志任务：从队列取出日志并输出到调试串口
 * 参  数：argument —— 未使用
 * 返回值：无（永不返回）
 * 说  明：优先级最低；无日志时阻塞在队列上，不占 CPU
 ******************************************************************************/
void TaskLog(void *argument)
{
    log_msg_t m;                                            // 取出的日志

    /*==============================
     *  #1. 任务主循环（永不退出）
     *==============================*/
    for (;;)
    {
        /*==============================
         *  #2. 等一条日志，取到就输出
         *==============================*/
        if (xQueueReceive(s_log_queue, &m, portMAX_DELAY) == pdTRUE)    // 阻塞等待
        {
            log_write_sync(m.text, m.len);                              // 串行化输出，不会交错
        }
    }
}