/*******************************************************************************
 * 文件   ：time_service.c
 * 功能   ：时间服务实现（基于 RTC）
 * 说明   ：全工程唯一的时间来源；用互斥量保证多任务并发读写安全；
 *          用备份寄存器判断"是否曾被正确校时"，据此给出时间可信标志
 ******************************************************************************/

/* Includes ------------------------------------------------------------------*/
#include "time_service.h"
#include "rtc_port.h"
#include "FreeRTOS.h"
#include "task.h"
#include "semphr.h"
#include <stddef.h>

/* Private define ------------------------------------------------------------*/
/* 是否严格要求"时间有效"才认为可信
   1 = 严格模式（产品）：时间无效即不可信，供电决策会拒绝启动设备
   0 = 调试模式：暂不限制，便于在没有校时源时推进开发 */
#define TIME_ENFORCE_VALID      0

/* Private variables ---------------------------------------------------------*/
static SemaphoreHandle_t s_time_mutex  = NULL;          // 时间读写互斥量
static volatile bool     s_time_synced = false;         // 是否曾被正确校时（单写多读）

/* Exported functions --------------------------------------------------------*/

/*******************************************************************************
 * 函数名：time_service_init
 * 功  能：初始化时间服务，并判断 RTC 中的时间是否可信
 * 参  数：无
 * 返回值：无
 * 说  明：必须在启动调度器之前调用；
 *         时间可信 = 备份寄存器标记存在（说明曾校时过且 VBAT 未掉电）
 ******************************************************************************/
void time_service_init(void)
{
    /*==============================
     *  #1. 创建时间读写互斥量
     *==============================*/
    s_time_mutex = xSemaphoreCreateMutex();             // 保护 RTC 读写

    /*==============================
     *  #2. 读取备份寄存器标记判断时间是否可信
     *==============================*/
    s_time_synced = rtc_port_was_synced();              // 曾校时过即为可信
}

/*******************************************************************************
 * 函数名：time_service_get
 * 功  能：读取当前时间
 * 参  数：t —— 接收时间的输出指针
 * 返回值：true 表示读取成功，false 表示失败
 * 说  明：读取结果同时反映 RTC 是否可正常访问
 ******************************************************************************/
bool time_service_get(app_time_t *t)
{
    rtc_port_time_t rt;
    bool ok = false;

    /*==============================
     *  #1. 参数与初始化状态检查
     *==============================*/
    if ((t == NULL) || (s_time_mutex == NULL))
    {
        return false;                                   // 参数错误或尚未初始化
    }

    /*==============================
     *  #2. 取锁后读取 RTC
     *==============================*/
    if (xSemaphoreTake(s_time_mutex, pdMS_TO_TICKS(10)) != pdTRUE)
    {
        return false;                                   // 取锁超时
    }

    if (rtc_port_get(&rt))
    {
        t->year   = rt.year;                            // 年
        t->month  = rt.month;                           // 月
        t->day    = rt.day;                             // 日
        t->hour   = rt.hour;                            // 时
        t->minute = rt.minute;                          // 分
        t->second = rt.second;                          // 秒
        ok = true;                                      // 标记读取成功
    }

    xSemaphoreGive(s_time_mutex);                       // 归还互斥量

    return ok;
}

/*******************************************************************************
 * 函数名：time_service_set
 * 功  能：设置当前时间（校时入口）
 * 参  数：t —— 要设置的时间
 * 返回值：无
 * 说  明：写入成功后写备份寄存器标记，并把时间置为可信；
 *         将来北斗、调试通道的校时都调用这里
 ******************************************************************************/
void time_service_set(const app_time_t *t)
{
    rtc_port_time_t rt;
    bool ok = false;

    /*==============================
     *  #1. 参数与初始化状态检查
     *==============================*/
    if ((t == NULL) || (s_time_mutex == NULL))
    {
        return;                                         // 参数错误或尚未初始化
    }

    /*==============================
     *  #2. 取锁后写入 RTC
     *==============================*/
    if (xSemaphoreTake(s_time_mutex, pdMS_TO_TICKS(10)) != pdTRUE)
    {
        return;                                         // 取锁超时
    }

    rt.year   = t->year;                                // 年
    rt.month  = t->month;                               // 月
    rt.day    = t->day;                                 // 日
    rt.hour   = t->hour;                                // 时
    rt.minute = t->minute;                              // 分
    rt.second = t->second;                              // 秒

    ok = rtc_port_set(&rt);                             // 写入 RTC

    xSemaphoreGive(s_time_mutex);                       // 归还互斥量

    /*==============================
     *  #3. 写入成功后标记时间已被校时
     *==============================*/
    if (ok)
    {
        rtc_port_mark_synced();                         // 写备份寄存器标记
        s_time_synced = true;                           // 置为可信
    }
}

/*******************************************************************************
 * 函数名：time_service_is_reliable
 * 功  能：判断当前时间是否可信
 * 参  数：无
 * 返回值：true 表示时间可信，false 表示不可信
 * 说  明：供电决策层据此决定"是否允许按时间策略给设备供电"
 ******************************************************************************/
bool time_service_is_reliable(void)
{
    /*==============================
     *  #1. 按调试/产品模式返回结果
     *==============================*/
#if (TIME_ENFORCE_VALID == 1)
    return s_time_synced;                               // 严格模式：必须是曾校时过的时间
#else
    (void)s_time_synced;                                // 调试模式：暂不限制
    return true;                                        // 便于在没有校时源时推进开发
#endif
}

/*******************************************************************************
 * 函数名：time_service_uptime_sec
 * 功  能：读取上电至今的运行秒数
 * 参  数：无
 * 返回值：运行秒数
 * 说  明：与墙钟时间无关，用于"开机 10 分钟内保持北斗"这类判断
 ******************************************************************************/
uint32_t time_service_uptime_sec(void)
{
    /*==============================
     *  #1. 由系统 tick 直接换算
     *==============================*/
    return ((uint32_t)xTaskGetTickCount() / 1000UL);    // 毫秒换算成秒
}
